## drivers/misc/dsu_permissive/Kconfig
```kconfig
# SPDX-License-Identifier: GPL-2.0-only
config DSU_PERMISSIVE
	tristate "First-stage AVB view handling with DSU-only SELinux permissive"
	depends on ARM64
	depends on BLOCK && PROC_FS && KPROBES && KALLSYMS && TRACEPOINTS
	help
	  During Android first-stage init, temporarily present PID 1 with an
	  AVB HashtreeDisabled view for the host system and DSU.  When the AOSP
	  DSU boot marker is present, also perform the existing one-time SELinux
	  permissive transition during selinux_setup.  No dm-verity table rewrite
	  is implemented.

	  Select Y for an in-tree early-init integration, or M only when an
	  init_boot loader is responsible for loading the matching GKI module.
```

## kernel_device_modules-6.6/drivers/misc/miev/Kconfig
```kconfig
# SPDX-License-Identifier: GPL-2.0-only

config MIEV
	tristate "MiSight event provider"
	default m
	help
	  Build the MiSight kernel event provider.  It implements the
	  cdev_tevent_* ABI used by Xiaomi display, charger, audio and UFS
	  diagnostics and exposes the resulting records through /dev/miev.
```
